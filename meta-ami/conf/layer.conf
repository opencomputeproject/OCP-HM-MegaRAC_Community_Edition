## meta-ami/conf/layer.conf
```bitbake
# We have a conf and classes directory, add to BBPATH
BBPATH .= ":${LAYERDIR}"

# We have recipes-* directories, add to BBFILES
BBFILES += "${LAYERDIR}/recipes-*/*/*.bb \
            ${LAYERDIR}/recipes-*/*/*.bbappend \
            ${LAYERDIR}/recipes-*/*/*/*.bb \
            ${LAYERDIR}/recipes-*/*/*/*.bbappend \
            ${LAYERDIR}/meta-common/recipes-*/*/*.bb \
            ${LAYERDIR}/meta-common/recipes-*/*/*.bbappend \
           "

BBFILES_RESTRICTED += "${LAYERDIR}/meta-restricted/recipes-*/*/*.bb \
                       ${LAYERDIR}/meta-restricted/recipes-*/*/*.bbappend"

BBFILES:append = "${@bb.utils.contains('BBFILE_COLLECTIONS', 'restricted', BBFILES_RESTRICTED, '', d)}"

BBFILE_COLLECTIONS += "meta-ami"
BBFILE_PATTERN_meta-ami = "^${LAYERDIR}/"
BBFILE_PRIORITY_meta-ami = "14"

LAYERVERSION_meta-ami = "1"
LAYERSERIES_COMPAT_meta-ami = "kirkstone langdale"

IMAGE_INSTALL:append = " pef-alert-manager mail-alert-manager adcapp pwmtachtool intel-ipmi-oem webui-vue host-interface phosphor-snmp bmc-boot-check"

IMAGE_INSTALL:append = " ${@bb.utils.contains('IMAGE_FSTYPES', 'intel-pfr', '', 'ami-fw-update', d)}"
IMAGE_INSTALL:remove = " ${@bb.utils.contains('IMAGE_FSTYPES', 'intel-pfr', '', 'intel-fw-update', d)}"
IMAGE_FEATURES += "obmc-user-mgmt-ldap"

PRODUCT_GENERATION_TAG = "OT"

# DNS Tool
IMAGE_INSTALL:append = " bind-utils"

#NIC Management
#IMAGE_INSTALL:append = " nic-mgmt"

#NVMe Management
#IMAGE_INSTALL:append = " nvme-mgmt"

#BRCM Raid and HBA management
#IMAGE_INSTALL:append = " raid-mgmt hba-mgmt"

#Firmware Update CPLD
#IMAGE_INSTALL:append = " cpld-tool"

#dm-verity, rootfs verification
#IMAGE_CLASSES += "dm-verity-img"
#DM_VERITY_IMAGE = "obmc-phosphor-image"
#DM_VERITY_IMAGE_TYPE = "squashfs-xz"
#dm-verity

#verified boot
#SPL_BINARY = "spl/u-boot-spl.bin"
UBOOT_SIGN_ENABLE = "0"
SPL_SIGN_ENABLE = "0"
UBOOT_FITIMAGE_ENABLE = "0"

FIT_HASH_ALG = "sha256"
FIT_SIGN_ALG = "rsa2048"
FIT_SIGN_NUMBITS = "2048"
UBOOT_FIT_HASH_ALG = "sha256"
UBOOT_FIT_SIGN_ALG = "rsa2048"
UBOOT_FIT_SIGN_NUMBITS = "2048"

UBOOT_SIGN_KEYNAME = "rsa_oem_fitimage_key"
SPL_SIGN_KEYNAME = "rsa_oem_fitimage_key"

UBOOT_SIGN_KEYDIR = "${WORKDIR}"
SPL_SIGN_KEYDIR = "${WORKDIR}"
#verified boot
```

## meta-ami/meta-ami-devkit/conf/layer.conf
```bitbake
# We have a conf and classes directory, add to BBPATH
BBPATH .= ":${LAYERDIR}"

# We have recipes-* directories, add to BBFILES
BBFILES += "${LAYERDIR}/recipes-*/*/*.bb \
            ${LAYERDIR}/recipes-*/*/*.bbappend"

BBFILE_COLLECTIONS += "ami-devkit"
BBFILE_PATTERN_ami-devkit = ""
BBFILE_PRIORITY_ami-devkit = "5"
LAYERSERIES_COMPAT_ami-devkit = "dunfell"

#IMAGE_INSTALL_append += " poweron beepcode-mgr pch-time-sync id-led-off lpc-cmds io-app beeper-test rng-tools ac-boot-check logger-systemd kernel-panic-check ipmi-oem dimmsensor phosphor-node-manager-proxy"
## DO NOT EDIT BELOW - ADDED BY DEVNET
IMAGE_INSTALL_append += "pwmtachtool ipmitool phosphor-ipmi-kcs bmcweb phosphor-ipmi-net entity-manager jsnbd phosphor-user-manager adcapp dbus-sensors phosphor-network phosphor-sel-logger phosphor-ipmi-ipmb obmc-console obmc-ikvm default-fru"
```

## meta-ami/meta-ami-devkit/conf/machine/ami-devkit.conf
```bitbake
KMACHINE = "aspeed"
KERNEL_DEVICETREE = "${KMACHINE}-ast2600-evb-ami.dtb"
require conf/machine/include/ast2600.inc
require conf/machine/include/obmc-bsp-common.inc

UBOOT_MACHINE = "evb-ast2600a1_defconfig"
UBOOT_DEVICETREE = "ast2600a1-evb"

FLASH_SIZE = "32768"
FLASH_KERNEL_OFFSET = "1024"
FLASH_ROFS_OFFSET = "6144"
FLASH_RWFS_OFFSET = "29696"

PREFERRED_PROVIDER_virtual/bootloader = "u-boot-aspeed-sdk"
PREFERRED_PROVIDER_u-boot = "u-boot-aspeed-sdk"
PREFERRED_PROVIDER_u-boot-fw-utils = "u-boot-fw-utils-aspeed-sdk"

VIRTUAL-RUNTIME_skeleton_workbook = "${MACHINE}-config"

MACHINE_EXTRA_RDEPENDS += "udev-devicemodechange"

OBMC_MACHINE_FEATURES += "\
        obmc-phosphor-fan-mgmt \
        obmc-phosphor-chassis-mgmt \
        obmc-phosphor-flash-mgmt \
        obmc-host-ipmi \
        obmc-host-state-mgmt \
        obmc-chassis-state-mgmt \
        obmc-bmc-state-mgmt \
        "

#PREFERRED_PROVIDER_virtual/obmc-chassis-mgmt = "packagegroup-op-apps"
#PREFERRED_PROVIDER_virtual/obmc-fan-mgmt = "packagegroup-op-apps"
#PREFERRED_PROVIDER_virtual/obmc-flash-mgmt = "packagegroup-op-apps"
#PREFERRED_PROVIDER_virtual/obmc-system-mgmt = "packagegroup-op-apps"
PREFERRED_PROVIDER_virtual/obmc-inventory-data = "obmc-inventory"
PREFERRED_PROVIDER_virtual/obmc-host-ipmi-hw = "phosphor-ipmi-kcs"

PREFERRED_PROVIDER_virtual/obmc-chassis-mgmt = "packagegroup-x86-apps"
PREFERRED_PROVIDER_virtual/obmc-fan-mgmt = "packagegroup-x86-apps"
PREFERRED_PROVIDER_virtual/obmc-flash-mgmt = "packagegroup-x86-apps"
PREFERRED_PROVIDER_virtual/obmc-system-mgmt = "packagegroup-x86-apps"
VIRTUAL-RUNTIME_obmc-host-state-manager = "x86-power-control"
VIRTUAL-RUNTIME_obmc-chassis-state-manager = "x86-power-control"
VIRTUAL-RUNTIME_obmc-discover-system-state = "x86-power-control"
```

## meta-ami/meta-ampere/conf/layer.conf
```bitbake
# We have a conf and classes directory, add to BBPATH
BBPATH .= ":${LAYERDIR}"

# We have recipes-* directories, add to BBFILES
BBFILES += "${LAYERDIR}/meta-common/recipes-*/*/*.bb \
            ${LAYERDIR}/meta-common/recipes-*/*/*.bbappend \
            ${LAYERDIR}/recipes-*/*/*.bb \
            ${LAYERDIR}/recipes-*/*/*.bbappend"

BBFILE_COLLECTIONS += "ampere-layer"
BBFILE_PATTERN_ampere-layer := "^${LAYERDIR}/"
BBFILE_PRIORITY_ampere-layer = "7"
LAYERSERIES_COMPAT_ampere-layer = "gatesgarth hardknott dunfell"
```

## meta-ami/meta-aowanda/conf/layer.conf
```bitbake
# We have a conf and classes directory, add to BBPATH
BBPATH .= ":${LAYERDIR}"

# We have recipes-* directories, add to BBFILES
BBFILES += "${LAYERDIR}/recipes-*/*/*.bb \
            ${LAYERDIR}/recipes-*/*/*.bbappend "

BBFILE_COLLECTIONS += "aowanda"
BBFILE_PATTERN_aowanda = ""

LAYERSERIES_COMPAT_aowanda = "warrior zeus dunfell gatesgarth"
PREFERRED_VERSION_safec = "3.4"


IMAGE_INSTALL_append = "phosphor-pid-control bmcready ipmi-oem ipmitool  libpeci intelacd phosphor-node-manager-proxy set-hostname mac-settings iproute2 ac-boot-check host-powerstatus-trigger"


## DO NOT EDIT BELOW - ADDED BY DEVNET
IMAGE_INSTALL_append += "pwmtachtool ipmitool phosphor-ipmi-kcs bmcweb phosphor-ipmi-net entity-manager jsnbd phosphor-user-manager adcapp hostinventory dbus-sensors phosphor-network phosphor-sel-logger phosphor-ipmi-ipmb obmc-console obmc-ikvm default-fru"
```

## meta-ami/meta-aowanda/conf/machine/aowanda.conf
```bitbake
KMACHINE = "aspeed"
KERNEL_DEVICETREE = "${KMACHINE}-bmc-mitac-aowanda.dtb"

UBOOT_MACHINE = "evb-ast2600a1_defconfig"
UBOOT_DEVICETREE = "ast2600a1-evb"

require conf/machine/include/ast2600.inc
require conf/machine/include/obmc-bsp-common.inc

SERIAL_CONSOLES = "115200;ttyS4"
FLASH_SIZE = "32768"

FLASH_KERNEL_OFFSET = "1024"
FLASH_ROFS_OFFSET = "6144"
FLASH_RWFS_OFFSET = "31744"

MACHINE_EXTRA_RDEPENDS += "udev-devicemodechange"

OBMC_MACHINE_FEATURES += "\
        obmc-phosphor-fan-mgmt \
        obmc-phosphor-chassis-mgmt \
        obmc-phosphor-flash-mgmt \
        obmc-host-ipmi \
        obmc-host-state-mgmt \
        obmc-chassis-state-mgmt \
        obmc-bmc-state-mgmt \
        "

PREFERRED_PROVIDER_virtual/obmc-chassis-mgmt = "packagegroup-x86-apps"
PREFERRED_PROVIDER_virtual/obmc-fan-mgmt = "packagegroup-x86-apps"
PREFERRED_PROVIDER_virtual/obmc-flash-mgmt = "packagegroup-x86-apps"
PREFERRED_PROVIDER_virtual/obmc-system-mgmt = "packagegroup-x86-apps"
PREFERRED_PROVIDER_virtual/obmc-inventory-data = "obmc-inventory"
PREFERRED_PROVIDER_virtual/obmc-host-ipmi-hw = "phosphor-ipmi-kcs"
PREFERRED_PROVIDER_virtual/phosphor-led-manager-config-native = "aowanda-led-manager-config-native"

VIRTUAL-RUNTIME_obmc-host-state-manager = "x86-power-control"
VIRTUAL-RUNTIME_obmc-chassis-state-manager = "x86-power-control"
VIRTUAL-RUNTIME_obmc-discover-system-state = "x86-power-control"

PREFERRED_PROVIDER_virtual/kernel = "linux-ami-aspeed"
PREFERRED_VERSION_linux-ami-aspeed = "5.4.85"
```

## meta-ami/meta-aspeed/conf/layer.conf
```bitbake
# We have a conf and classes directory, add to BBPATH
BBPATH .= ":${LAYERDIR}"

# We have recipes-* directories, add to BBFILES
BBFILES += "${LAYERDIR}/recipes-*/*/*.bb \
	${LAYERDIR}/recipes-*/*/*.bbappend"

BBFILE_COLLECTIONS += "aspeed"
BBFILE_PATTERN_aspeed = "^${LAYERDIR}/"
BBFILE_PRIORITY_aspeed = "6"
LAYERVERSION_aspeed = "1"
LAYERSERIES_COMPAT_aspeed = "thud warrior dunfell gatesgarth"

IMAGE_INSTALL_append += " watchdog-reset "
```

## meta-ami/meta-evb/meta-evb-aspeed/meta-evb-ast2600/conf/layer.conf
```bitbake
LOCALCONF_VERSION = "4"
# We have a conf and classes directory, add to BBPATH
BBPATH .= ":${LAYERDIR}"

# We have recipes-* directories, add to BBFILES
BBFILES += "${LAYERDIR}/recipes-*/*/*.bb \
            ${LAYERDIR}/recipes-*/*/*.bbappend"

BBFILE_COLLECTIONS += "evb-ast2600"
BBFILE_PATTERN_evb-ast2600 = "^${LAYERDIR}/"
BBFILE_PRIORITY_evb-ast2600 = "11"
LAYERSERIES_COMPAT_evb-ast2600 = "kirkstone langdale"
```

## meta-ami/meta-evb/meta-evb-aspeed/meta-evb-ast2600/conf/machine/evb-ast2600.conf
```bitbake
KERNEL_DEVICETREE = "aspeed-ast2600-evb.dtb"

UBOOT_MACHINE = "ast2600_openbmc_defconfig"
UBOOT_DEVICETREE = "ast2600-evb"
SPL_BINARY = "spl/u-boot-spl.bin"
# Disable hardware root of trust by default.
# If users want to enable secure boot,
# please do the following steps.
# 1. Set SOCSEC_SIGN_ENABLE to “1”.
# 2. Provide platform OTP config.
# There was an example in p10bmc.
# If users enable socsec signing but do not provide OTP config,
# u-boot will be built failed.
SOCSEC_SIGN_ENABLE = "0"

KMACHINE = "aspeed"

require conf/machine/include/obmc-evb-common.inc
require conf/machine/include/ast2600.inc
#require conf/machine/include/intel.inc

#TARGET_FPU = "hard"

MACHINE_FEATURES += "\
		     obmc-host-ipmi \
		     obmc-phosphor-fan-mgmt \
		     obmc-phosphor-chassis-mgmt \
		     obmc-phosphor-flash-mgmt \ 
		     obmc-host-state-mgmt \
		     obmc-chassis-state-mgmt \ 
		     obmc-bmc-state-mgmt \
		    "

PREFERRED_PROVIDER_u-boot-fw-utils ?= "u-boot-fw-utils-aspeed-sdk"
PREFERRED_PROVIDER_virtual/kernel = "linux-aspeed"
PREFERRED_PROVIDER_virtual/obmc-host-ipmi-hw = "phosphor-ipmi-kcs"
PREFERRED_PROVIDER_virtual/obmc-chassis-mgmt = "packagegroup-intel-apps"
PREFERRED_PROVIDER_virtual/obmc-fan-mgmt = "packagegroup-intel-apps"
PREFERRED_PROVIDER_virtual/obmc-flash-mgmt = "packagegroup-intel-apps"
PREFERRED_PROVIDER_virtual/obmc-system-mgmt = "packagegroup-intel-apps"
VIRTUAL-RUNTIME_obmc-host-state-manager = "x86-power-control"
VIRTUAL-RUNTIME_obmc-chassis-state-manager = "x86-power-control"
VIRTUAL-RUNTIME_obmc-discover-system-state = "x86-power-control"


SERIAL_CONSOLES = "115200;ttyS4"

# AST2600 EVB has 64MB SPI flash
FLASH_SIZE = "65536"
```

## meta-ami/meta-jade/conf/layer.conf
```bitbake
# We have a conf and classes directory, add to BBPATH
BBPATH .= ":${LAYERDIR}"

# We have recipes-* directories, add to BBFILES
BBFILES += "${LAYERDIR}/recipes-*/*/*.bb \
            ${LAYERDIR}/recipes-*/*/*.bbappend"

BBFILE_COLLECTIONS += "jade"
BBFILE_PATTERN_jade := ""
BBFILE_PRIORITY_jade = "8"
LAYERSERIES_COMPAT_jade-layer = "gatesgarth hardknott dunfell"

IMAGE_INSTALL_append += " phosphor-pid-control"
## DO NOT EDIT BELOW - ADDED BY DEVNET
IMAGE_INSTALL_append += "pwmtachtool ipmitool bmcweb phosphor-ipmi-net entity-manager jsnbd phosphor-user-manager adcapp hostinventory dbus-sensors phosphor-sel-logger phosphor-network obmc-console obmc-ikvm upgrade-preserve-config"
```

## meta-ami/meta-jade/conf/machine/mtjade.conf
```bitbake
KMACHINE = "aspeed"
KERNEL_DEVICETREE = "${KMACHINE}-bmc-ampere-${MACHINE}.dtb"

require conf/machine/include/ast2500.inc
require conf/machine/include/obmc-bsp-common.inc
require conf/distro/include/phosphor-isolation.inc

OBMC_POWER_SUPPLY_INSTANCES = "0 1"

# U-BOOT

# Ampere u-boot
UBOOT_MACHINE = "ast_g5_phy_config"
PREFERRED_PROVIDER_virtual/bootloader = "u-boot-aspeed"

# OSP u-boot
# UBOOT_MACHINE = "evb-ast2500_defconfig"
# UBOOT_DEVICETREE = "ast2500-evb"
# PREFERRED_PROVIDER_virtual/bootloader = "u-boot-aspeed-sdk"
# PREFERRED_PROVIDER_u-boot = "u-boot-aspeed-sdk"
# PREFERRED_PROVIDER_u-boot-fw-utils = "u-boot-fw-utils-aspeed-sdk"

# KERNEL

FLASH_SIZE = "65536"

# 5.10 layout
FLASH_UBOOT_OFFSET  = "0"
FLASH_KERNEL_OFFSET = "512"
FLASH_ROFS_OFFSET   = "5632"
FLASH_RWFS_OFFSET   = "49152"

# 5.14 layout
# FLASH_UBOOT_OFFSET  = "0"
# FLASH_KERNEL_OFFSET = "1024"
# FLASH_ROFS_OFFSET   = "10240"
# FLASH_RWFS_OFFSET   = "43008"

# Ampere Kernel
PREFERRED_PROVIDER_virtual/kernel = "linux-ampere"
PREFERRED_VERSION_linux-ampere = "5.10.%"
# PREFERRED_VERSION_linux-ampere = "5.14.%"

VIRTUAL-RUNTIME_skeleton_workbook = "${MACHINE}-config"

MACHINE_EXTRA_RDEPENDS += "udev-devicemodechange"


OBMC_MACHINE_FEATURES += "\
        obmc-phosphor-chassis-mgmt \
        obmc-phosphor-flash-mgmt \
        obmc-host-state-mgmt \
        obmc-chassis-state-mgmt \
        obmc-host-ipmi \
        obmc-bmc-state-mgmt \
        obmc-phosphor-fan-mgmt \
        "

VOLATILE_LOG_DIR = "no"

OBMC_IMAGE_EXTRA_INSTALL_append = "\
                                   mtjade-utils \
                                   ampere-usbnet \
                                   driver-binder \
                                   ampere-mac-update \
                                   ampere-flash-utils \
                                   peripheral-manager \
                                   virtual-media \
                                   psu-inventory-update \
                                   ampere-platform-mgmt \
				   logger-systemd \
                                   ampere-platform-init \
                                   mtjade-gpio-config \
                                  "

PREFERRED_PROVIDER_virtual/obmc-chassis-mgmt = "packagegroup-ampere-apps"
PREFERRED_PROVIDER_virtual/obmc-system-mgmt = "packagegroup-ampere-apps"
PREFERRED_PROVIDER_virtual/obmc-host-ipmi-hw = "phosphor-ipmi-ssif"
PREFERRED_PROVIDER_virtual/obmc-flash-mgmt = "packagegroup-ampere-apps"
PREFERRED_PROVIDER_virtual/phosphor-ipmi-fru-hostfw-config ?= "hostboot-inventory-config-native"
PREFERRED_PROVIDER_virtual/phosphor-led-manager-config-native = "mtjade-led-manager-config-native"
PREFERRED_PROVIDER_virtual/obmc-fan-mgmt = "packagegroup-ampere-apps"
```

## meta-ami/meta-nuvoton/conf/layer.conf
```bitbake
# We have a conf and classes directory, add to BBPATH
BBPATH .= ":${LAYERDIR}"

# We have recipes-* directories, add to BBFILES
BBFILES += "${LAYERDIR}/recipes-*/*/*.bb \
	${LAYERDIR}/recipes-*/*/*.bbappend"

BBFILE_COLLECTIONS += "nuvoton"
BBFILE_PATTERN_nuvoton = "^${LAYERDIR}/"
BBFILE_PRIORITY_nuvoton = "6"
LAYERVERSION_nuvoton = "1"
LAYERSERIES_COMPAT_nuvoton = "thud warrior dunfell"
```

## meta-ami/meta-tiogapass/conf/bblayers.conf.sample
```bitbake
# LAYER_CONF_VERSION is increased each time build/conf/bblayers.conf
# changes incompatibly
LCONF_VERSION = "8"

BBPATH = "${TOPDIR}"
BBFILES ?= ""

BBLAYERS ?= " \
  ##OEROOT##/meta \
  ##OEROOT##/meta-openembedded/meta-oe \
  ##OEROOT##/meta-openembedded/meta-networking \
  ##OEROOT##/meta-openembedded/meta-python \
  ##OEROOT##/meta-openembedded/meta-perl \
  ##OEROOT##/meta-openembedded/meta-webserver \
  ##OEROOT##/meta-phosphor \
  ##OEROOT##/meta-aspeed \
  ##OEROOT##/meta-ami \
  ##OEROOT##/meta-ami/meta-aspeed \
  "
BBLAYERS_NON_REMOVABLE ?= " \
  ##OEROOT##/meta \
  ##OEROOT##/meta-openembedded/meta-oe \
  ##OEROOT##/meta-openembedded/meta-networking \
  ##OEROOT##/meta-openembedded/meta-python \
  ##OEROOT##/meta-openembedded/meta-webserver \
  ##OEROOT##/meta-openembedded/meta-perl \
  ##OEROOT##/meta-phosphor \
  ##OEROOT##/meta-aspeed \
  ##OEROOT##/meta-ami/meta-aspeed \
  "

## DO NOT EDIT BELOW - ADDED BY SCRIPT
BBLAYERS += "##OEROOT##/meta-ami/meta-tiogapass"
```
