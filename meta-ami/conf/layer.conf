## meta-ami/meta-tiogapass/conf/layer.conf
```bitbake
# We have a conf and classes directory, add to BBPATH
BBPATH .= ":${LAYERDIR}"

# We have recipes-* directories, add to BBFILES
BBFILES += "${LAYERDIR}/recipes-*/*/*.bb \
            ${LAYERDIR}/recipes-*/*/*.bbappend"

BBFILE_COLLECTIONS += "tiogapass"
BBFILE_PATTERN_tiogapass = ""
BBFILE_PRIORITY_tiogapass = "5"
LAYERSERIES_COMPAT_tiogapass = "dunfell"

IMAGE_INSTALL_append += " poweron beepcode-mgr pch-time-sync id-led-off lpc-cmds io-app beeper-test rng-tools ac-boot-check logger-systemd kernel-panic-check ipmi-oem dimmsensor phosphor-node-manager-proxy"
## DO NOT EDIT BELOW - ADDED BY DEVNET
IMAGE_INSTALL_append += "pwmtachtool ipmitool phosphor-ipmi-kcs bmcweb phosphor-ipmi-net entity-manager jsnbd phosphor-user-manager adcapp dbus-sensors phosphor-network phosphor-sel-logger phosphor-ipmi-ipmb obmc-console obmc-ikvm default-fru"
```

## meta-ami/meta-tiogapass/conf/machine/tiogapass.conf
```bitbake
KMACHINE = "aspeed"
KERNEL_DEVICETREE = "${KMACHINE}-bmc-facebook-${MACHINE}.dtb"

require conf/machine/include/ast2500.inc
require conf/machine/include/obmc-bsp-common.inc

UBOOT_MACHINE = "evb-ast2500_defconfig"
UBOOT_DEVICETREE = "ast2500-evb"

FLASH_SIZE = "32768"
FLASH_KERNEL_OFFSET = "640"
FLASH_ROFS_OFFSET = "6080"
FLASH_RWFS_OFFSET = "30912"

PREFERRED_PROVIDER_virtual/bootloader = "u-boot-aspeed-sdk"
PREFERRED_PROVIDER_u-boot = "u-boot-aspeed-sdk"
PREFERRED_PROVIDER_u-boot-fw-utils = "u-boot-fw-utils-aspeed-sdk"

VIRTUAL-RUNTIME_skeleton_workbook = "${MACHINE}-config"

MACHINE_EXTRA_RDEPENDS += "udev-devicemodechange"

OBMC_MACHINE_FEATURES += "\
        obmc-phosphor-fan-mgmt \
        obmc-phosphor-chassis-mgmt \
        obmc-phosphor-flash-mgmt \
        obmc-host-ipmi \
        obmc-host-state-mgmt \
        obmc-chassis-state-mgmt \
        obmc-bmc-state-mgmt \
        "

#PREFERRED_PROVIDER_virtual/obmc-chassis-mgmt = "packagegroup-op-apps"
#PREFERRED_PROVIDER_virtual/obmc-fan-mgmt = "packagegroup-op-apps"
#PREFERRED_PROVIDER_virtual/obmc-flash-mgmt = "packagegroup-op-apps"
#PREFERRED_PROVIDER_virtual/obmc-system-mgmt = "packagegroup-op-apps"
PREFERRED_PROVIDER_virtual/obmc-inventory-data = "obmc-inventory"
PREFERRED_PROVIDER_virtual/obmc-host-ipmi-hw = "phosphor-ipmi-kcs"
PREFERRED_PROVIDER_virtual/phosphor-led-manager-config-native ?= "intel-led-manager-config-native"

PREFERRED_PROVIDER_virtual/obmc-chassis-mgmt = "packagegroup-x86-apps"
PREFERRED_PROVIDER_virtual/obmc-fan-mgmt = "packagegroup-x86-apps"
PREFERRED_PROVIDER_virtual/obmc-flash-mgmt = "packagegroup-x86-apps"
PREFERRED_PROVIDER_virtual/obmc-system-mgmt = "packagegroup-x86-apps"
VIRTUAL-RUNTIME_obmc-host-state-manager = "x86-power-control"
VIRTUAL-RUNTIME_obmc-chassis-state-manager = "x86-power-control"
VIRTUAL-RUNTIME_obmc-discover-system-state = "x86-power-control"
```

## meta-intel/meta-s2600wf/conf/machine/s2600wf.conf
```bitbake
KMACHINE = "aspeed"
KERNEL_DEVICETREE = "${KMACHINE}-bmc-intel-s2600wf.dtb"

require conf/machine/include/ast2500.inc
require conf/machine/include/obmc-bsp-common.inc
require conf/machine/include/intel.inc

UBOOT_MACHINE = "ast_g5_phy_config"

FLASH_SIZE = "32768"

FLASH_KERNEL_OFFSET = "640"
FLASH_ROFS_OFFSET = "6080"
FLASH_RWFS_OFFSET = "30912"

VIRTUAL-RUNTIME_skeleton_workbook = "${MACHINE}-config"
```

## meta-phosphor/conf/machine/include/unpack.inc
```bitbake
FILESPATH =. "${TOPDIR}/../openbmc_modules:"
S = "${WORKDIR}/${PN}"
SRC_URI = "file://${PN}"
SRCPV = "${AUTOREV}"
```

## openbmc_modules/linux/Documentation/devicetree/bindings/i2c/i2c-npcm7xx.txt
```
Nuvoton NPCM7XX I2C bus

The NPCM750x includes sixteen I2C bus controllers. All Controllers support
both master and slave mode. Each controller has two 16 byte HW FIFO for TX and
RX.

Required properties:
- compatible      : must be "nuvoton,npcm750-i2c"
- reg             : Offset and length of the register set for the device.
- interrupts      : Contain the I2C interrupt with flags for falling edge.
- clocks          : phandle of I2C reference clock.

Optional:
- bus-frequency   : Contain the I2C bus frequency,
			the default I2C bus frequency is 100000.
- pinctrl-0       : for example <&smbX_pins>, X is module number
			(on NPCM7XX it's 0 to 15)
- pinctrl-names   : should be set to "default"
Example:

	i2c0: i2c@80000 {
		compatible = "nuvoton,npcm750-i2c";
		reg = <0x80000 0x1000>;
		clocks = <&clk NPCM7XX_CLK_APB2>;
		bus-frequency = <100000>;
		interrupts = <GIC_SPI 64 IRQ_TYPE_LEVEL_HIGH>;
		pinctrl-names = "default";
		pinctrl-0 = <&smb0_pins>;
	};
```

## openbmc_modules/linux/Documentation/devicetree/bindings/mfd/intel,peci-client.yaml
```yaml
# SPDX-License-Identifier: GPL-2.0
%YAML 1.2
---
$id: http://devicetree.org/schemas/mfd/intel,peci-client.yaml#
$schema: http://devicetree.org/meta-schemas/core.yaml#

title: Intel PECI Client Device Tree Bindings

maintainers:
  - Jae Hyun Yoo <jae.hyun.yoo@linux.intel.com>

description: |
  PECI (Platform Environment Control Interface) is a one-wire bus interface
  that provides a communication channel from PECI clients in Intel processors
  and chipset components to external monitoring or control devices. PECI is
  designed to support the following sideband functions:
  - Processor and DRAM thermal management
  - Platform Manageability
  - Processor Interface Tuning and Diagnostics
  - Failure Analysis

properties:
  compatible:
    const: intel,peci-client

  reg:
    description: |
      Address of a client CPU. According to the PECI specification, client
      addresses start from 0x30.
    maxItems: 1

required:
  - compatible
  - reg

examples:
  - |
    #include <dt-bindings/interrupt-controller/arm-gic.h>
    #include <dt-bindings/clock/ast2600-clock.h>
    peci: bus@1e78b000 {
        compatible = "simple-bus";
        #address-cells = <1>;
        #size-cells = <1>;
        ranges = <0x0 0x1e78b000 0x60>;

        peci0: peci-bus@0 {
            compatible = "aspeed,ast2600-peci";
            reg = <0x0 0x100>;
            #address-cells = <1>;
            #size-cells = <0>;
            interrupts = <GIC_SPI 38 IRQ_TYPE_LEVEL_HIGH>;
            clocks = <&syscon ASPEED_CLK_GATE_REF0CLK>;
            resets = <&syscon ASPEED_RESET_PECI>;
            clock-frequency = <24000000>;

            peci-client@30 {
                compatible = "intel,peci-client";
                reg = <0x30>;
            };

            peci-client@31 {
                compatible = "intel,peci-client";
                reg = <0x31>;
            };
        };
    };
...
```

## openbmc_modules/linux/Documentation/devicetree/bindings/peci/peci-aspeed.yaml
```yaml
# SPDX-License-Identifier: GPL-2.0
%YAML 1.2
---
$id: http://devicetree.org/schemas/peci/peci-aspeed.yaml#
$schema: http://devicetree.org/meta-schemas/core.yaml#

title: Aspeed PECI Bus Device Tree Bindings

maintainers:
  - Jae Hyun Yoo <jae.hyun.yoo@linux.intel.com>

properties:
  compatible:
    enum:
      - aspeed,ast2400-peci
      - aspeed,ast2500-peci
      - aspeed,ast2600-peci

  reg:
    maxItems: 1

  "#address-cells":
    # Required to define a client address.
    const: 1

  "#size-cells":
    # Required to define a client address.
    const: 0

  interrupts:
    maxItems: 1

  clocks:
    description: |
      Clock source for PECI controller. Should reference the external
      oscillator clock.
    maxItems: 1

  resets:
    maxItems: 1

  clock-frequency:
    # Operation frequency of PECI controller in units of Hz.
    minimum: 187500
    maximum: 24000000

  msg-timing:
    description: |
      Message timing negotiation period. This value will determine the period
      of message timing negotiation to be issued by PECI controller. The unit
      of the programmed value is four times of PECI clock period.
    allOf:
      - $ref: /schemas/types.yaml#/definitions/uint32
      - minimum: 0
        maximum: 255
        default: 1

  addr-timing:
    description: |
      Address timing negotiation period. This value will determine the period
      of address timing negotiation to be issued by PECI controller. The unit
      of the programmed value is four times of PECI clock period.
    allOf:
      - $ref: /schemas/types.yaml#/definitions/uint32
      - minimum: 0
        maximum: 255
        default: 1

  rd-sampling-point:
    description: |
      Read sampling point selection. The whole period of a bit time will be
      divided into 16 time frames. This value will determine the time frame
      in which the controller will sample PECI signal for data read back.
      Usually in the middle of a bit time is the best.
    allOf:
      - $ref: /schemas/types.yaml#/definitions/uint32
      - minimum: 0
        maximum: 15
        default: 8

  cmd-timeout-ms:
    # Command timeout in units of ms.
    allOf:
      - $ref: /schemas/types.yaml#/definitions/uint32
      - minimum: 1
        maximum: 60000
        default: 1000

required:
  - compatible
  - reg
  - "#address-cells"
  - "#size-cells"
  - interrupts
  - clocks
  - resets
  - clock-frequency

examples:
  - |
    #include <dt-bindings/interrupt-controller/arm-gic.h>
    #include <dt-bindings/clock/ast2600-clock.h>
    peci: bus@1e78b000 {
        compatible = "simple-bus";
        #address-cells = <1>;
        #size-cells = <1>;
        ranges = <0x0 0x1e78b000 0x60>;

        peci0: peci-bus@0 {
            compatible = "aspeed,ast2600-peci";
            reg = <0x0 0x100>;
            #address-cells = <1>;
            #size-cells = <0>;
            interrupts = <GIC_SPI 38 IRQ_TYPE_LEVEL_HIGH>;
            clocks = <&syscon ASPEED_CLK_GATE_REF0CLK>;
            resets = <&syscon ASPEED_RESET_PECI>;
            clock-frequency = <24000000>;
            msg-timing = <1>;
            addr-timing = <1>;
            rd-sampling-point = <8>;
            cmd-timeout-ms = <1000>;
        };
    };
...
```

## openbmc_modules/linux/Documentation/devicetree/bindings/peci/peci-bus.yaml
```yaml
# SPDX-License-Identifier: GPL-2.0
%YAML 1.2
---
$id: http://devicetree.org/schemas/peci/peci-bus.yaml#
$schema: http://devicetree.org/meta-schemas/core.yaml#

title: Generic Device Tree Bindings for PECI bus

maintainers:
  - Jae Hyun Yoo <jae.hyun.yoo@linux.intel.com>

description: |
  PECI (Platform Environment Control Interface) is a one-wire bus interface that
  provides a communication channel from Intel processors and chipset components
  to external monitoring or control devices. PECI is designed to support the
  following sideband functions:

  * Processor and DRAM thermal management
    - Processor fan speed control is managed by comparing Digital Thermal
      Sensor (DTS) thermal readings acquired via PECI against the
      processor-specific fan speed control reference point, or TCONTROL. Both
      TCONTROL and DTS thermal readings are accessible via the processor PECI
      client. These variables are referenced to a common temperature, the TCC
      activation point, and are both defined as negative offsets from that
      reference.
    - PECI based access to the processor package configuration space provides
      a means for Baseboard Management Controllers (BMC) or other platform
      management devices to actively manage the processor and memory power
      and thermal features.

  * Platform Manageability
    - Platform manageability functions including thermal, power, and error
      monitoring. Note that platform 'power' management includes monitoring
      and control for both the processor and DRAM subsystem to assist with
      data center power limiting.
    - PECI allows read access to certain error registers in the processor MSR
      space and status monitoring registers in the PCI configuration space
      within the processor and downstream devices.
    - PECI permits writes to certain registers in the processor PCI
      configuration space.

  * Processor Interface Tuning and Diagnostics
    - Processor interface tuning and diagnostics capabilities
      (Intel Interconnect BIST). The processors Intel Interconnect Built In
      Self Test (Intel IBIST) allows for infield diagnostic capabilities in
      the Intel UPI and memory controller interfaces. PECI provides a port to
      execute these diagnostics via its PCI Configuration read and write
      capabilities.

  * Failure Analysis
    - Output the state of the processor after a failure for analysis via
      Crashdump.

  PECI uses a single wire for self-clocking and data transfer. The bus
  requires no additional control lines. The physical layer is a self-clocked
  one-wire bus that begins each bit with a driven, rising edge from an idle
  level near zero volts. The duration of the signal driven high depends on
  whether the bit value is a logic '0' or logic '1'. PECI also includes
  variable data transfer rate established with every message. In this way, it
  is highly flexible even though underlying logic is simple.

  The interface design was optimized for interfacing between an Intel
  processor and chipset components in both single processor and multiple
  processor environments. The single wire interface provides low board
  routing overhead for the multiple load connections in the congested routing
  area near the processor and chipset components. Bus speed, error checking,
  and low protocol overhead provides adequate link bandwidth and reliability
  to transfer critical device operating conditions and configuration
  information.

  PECI subsystem provides single or multiple bus nodes support so each bus can
  have one adapter node and multiple device specific client nodes that can be
  attached to the PECI bus so each processor client's features can be supported
  by the client node through an adapter connection in the bus.

properties:
  compatible:
    const: simple-bus

  "#address-cells":
    # Required to define bus device control resource address.
    const: 1

  "#size-cells":
    # Required to define bus device control resource address.
    const: 1

  ranges: true

required:
  - compatible
  - "#address-cells"
  - "#size-cells"
  - ranges

examples:
  - |
    #include <dt-bindings/interrupt-controller/arm-gic.h>
    #include <dt-bindings/clock/ast2600-clock.h>
    peci: bus@1e78b000 {
        compatible = "simple-bus";
        #address-cells = <1>;
        #size-cells = <1>;
        ranges = <0x0 0x1e78b000 0x200>;

        peci0: peci-bus@0 {
            compatible = "aspeed,ast2600-peci";
            reg = <0x0 0x100>;
            #address-cells = <1>;
            #size-cells = <0>;
            interrupts = <GIC_SPI 38 IRQ_TYPE_LEVEL_HIGH>;
            clocks = <&syscon ASPEED_CLK_GATE_REF0CLK>;
            resets = <&syscon ASPEED_RESET_PECI>;
            clock-frequency = <24000000>;
        };

        // Just an example. ast2600 doesn't have a second PECI module actually.
        peci1: peci-bus@100 {
            compatible = "aspeed,ast2600-peci";
            reg = <0x100 0x100>;
            #address-cells = <1>;
            #size-cells = <0>;
            interrupts = <GIC_SPI 39 IRQ_TYPE_LEVEL_HIGH>;
            clocks = <&syscon ASPEED_CLK_GATE_REF0CLK>;
            resets = <&syscon ASPEED_RESET_PECI>;
            clock-frequency = <24000000>;
        };
    };
...
```
